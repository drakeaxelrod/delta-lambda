## boards/shields/delta_lambda/Kconfig.defconfig
```kconfig
if SHIELD_DELTA_LAMBDA_LEFT

config ZMK_KEYBOARD_NAME
    default "Delta Lambda"

config ZMK_SPLIT_ROLE_CENTRAL
    default y

endif

if SHIELD_DELTA_LAMBDA_LEFT || SHIELD_DELTA_LAMBDA_RIGHT

config ZMK_SPLIT
    default y

endif
```

## config/boards/shields/delta_lambda/Kconfig.defconfig
```kconfig
if SHIELD_DELTA_LAMBDA_LEFT

config ZMK_KEYBOARD_NAME
    default "Lambda"

config ZMK_SPLIT_ROLE_CENTRAL
    default y

endif

if SHIELD_DELTA_LAMBDA_RIGHT

config ZMK_KEYBOARD_NAME
    default "Lambda Right"

endif

if SHIELD_DELTA_LAMBDA_LEFT || SHIELD_DELTA_LAMBDA_RIGHT

config ZMK_SPLIT
    default y

endif
```

## config/boards/shields/delta_lambda/Kconfig.shield
```kconfig
config SHIELD_DELTA_LAMBDA_LEFT
    def_bool $(shields_list_contains,delta_lambda_left)

config SHIELD_DELTA_LAMBDA_RIGHT
    def_bool $(shields_list_contains,delta_lambda_right)
```
